// Cross-feature OLED screen framework: one owner for the full-screen
// chrome and the button routing, with features (messenger, sensors)
// as page plugins. Tracked by issue #3.
//
// Gesture contract (depth-independent):
//   BOOT tap          next top-level screen (status -> first screen ->
//                     ... -> wraps back to status)
//   BOOT hold .7-5s   back ONE level: the active page pops an internal
//                     screen if it has one; at its root the framework
//                     exits to status
//   BOOT hold >5s     never consumed here - global gestures (pairing,
//                     console) stay reachable
//   POWER tap         on_next: advance the cursor / next item
//   POWER hold ~1s    on_select: commit whatever is highlighted
//   POWER hold 4s     PMU hardware power-off; cannot be intercepted,
//                     which is why commit sits at 1 s with margin
//
// Chrome (matches the design doc in issue #3): an 11 px INVERTED
// header bar (8x8 glyph, UPPERCASE title, live spinner at the right
// edge), the body region, and an INVERTED bottom hint bar whose lines
// follow the fixed grammar "Tap|Hold BUTTON: action" with silkscreen
// button names (POWER, BOOT). The framework draws all of that; pages
// render only the body and decide what next/select/back mean.
#pragma once

#include <Adafruit_GFX.h>
#include <Fonts/Picopixel.h>
#include <stdint.h>
#include <string.h>
#include <initializer_list>

#include "../Common/OledText.h"

namespace Display {
namespace Screens {

// ---- shared glyphs (8x8, GFX drawBitmap format, MSB = leftmost) ----
// Generated by tools/oled_icons_gen.py; the pixel-art strings there
// are the source of truth - regenerate, never hand-edit.
static const uint8_t GLYPH_ENVELOPE[8] PROGMEM = { 0xFF, 0x81, 0xC3, 0xA5, 0x99, 0x81, 0xFF, 0x00 };
static const uint8_t GLYPH_INBOX[8]    PROGMEM = { 0x18, 0x18, 0x7E, 0x3C, 0x18, 0x81, 0x81, 0xFF };
static const uint8_t GLYPH_SEND[8]     PROGMEM = { 0x18, 0x3C, 0x7E, 0x18, 0x18, 0x81, 0x81, 0xFF };
static const uint8_t GLYPH_PIN[8]      PROGMEM = { 0x00, 0x3C, 0x7E, 0x66, 0x7E, 0x3C, 0x18, 0x18 };
static const uint8_t GLYPH_COMPASS[8]  PROGMEM = { 0x18, 0x18, 0x3C, 0xFF, 0xFF, 0x3C, 0x18, 0x18 };
static const uint8_t GLYPH_THERMO[8]   PROGMEM = { 0x30, 0x48, 0x58, 0x58, 0x48, 0x84, 0xB4, 0x78 };
static const uint8_t GLYPH_BATTERY[8]  PROGMEM = { 0x00, 0x7E, 0x42, 0x5B, 0x5B, 0x42, 0x7E, 0x00 };
static const uint8_t GLYPH_LIVE[8]     PROGMEM = { 0x38, 0x44, 0x83, 0x87, 0x81, 0x44, 0x38, 0x00 };
static const uint8_t GLYPH_CLOCK[8]    PROGMEM = { 0x7C, 0x92, 0x92, 0x9E, 0x82, 0x82, 0x7C, 0x00 };
static const uint8_t GLYPH_CHECK[8]    PROGMEM = { 0x00, 0x01, 0x02, 0x04, 0x88, 0x50, 0x20, 0x00 };
static const uint8_t GLYPH_CHECK2[8]   PROGMEM = { 0xFF, 0xFE, 0xFD, 0xFB, 0x77, 0xAF, 0xDF, 0xFF };
static const uint8_t GLYPH_CROSS[8]    PROGMEM = { 0x00, 0x42, 0x24, 0x18, 0x18, 0x24, 0x42, 0x00 };
static const uint8_t GLYPH_PERSON[8]   PROGMEM = { 0x18, 0x3C, 0x3C, 0x18, 0x3C, 0x7E, 0xFF, 0x00 };
static const uint8_t GLYPH_CURSOR[8]   PROGMEM = { 0x80, 0xC0, 0xE0, 0xF0, 0xE0, 0xC0, 0x80, 0x00 };
// Live-activity spinner, 4 frames, quarter gap rotating clockwise.
static const uint8_t GLYPH_SPIN[4][8] PROGMEM = {
  { 0x00, 0x40, 0x82, 0x82, 0x82, 0x44, 0x38, 0x00 },
  { 0x38, 0x44, 0x80, 0x80, 0x80, 0x40, 0x38, 0x00 },
  { 0x38, 0x44, 0x82, 0x82, 0x82, 0x04, 0x00, 0x00 },
  { 0x38, 0x04, 0x02, 0x02, 0x02, 0x44, 0x38, 0x00 },
};

// ---- layout constants ----
inline constexpr int16_t  HEADER_H        = 11;  // inverted bar height
inline constexpr int16_t  BODY_TOP        = HEADER_H + 2;  // 1px gap + 1px slack
inline constexpr uint32_t SPINNER_FRAME_MS = 250; // 4 frames/s, needs 4 Hz redraw
// BOOT gesture boundaries (POWER's are the PMU's own: tap vs 1 s IRQ).
inline constexpr unsigned long BOOT_HOLD_MS     = 700;
inline constexpr unsigned long BOOT_GLOBAL_MS   = 5000;  // past this: never ours

// One full-screen page. The framework draws chrome and routes input;
// the page renders the body and gives next/select/back their meaning.
struct ScreenPage {
  // Current header content (re-queried every frame: titles change
  // with internal state, e.g. MESSAGES -> SEND -> STATUS).
  void (*header)(const uint8_t** glyph, const char** title);
  // Up to `max` hint lines in the fixed grammar; return the count.
  size_t (*hints)(const char** out, size_t max);
  // Body, clipped to [y_top, y_bottom).
  void (*render_body)(GFXcanvas1& area, int16_t y_top, int16_t y_bottom);
  void (*on_enter)();     // page became active
  void (*on_exit)();      // page left (any reason)
  void (*on_next)();      // POWER tap
  void (*on_select)();    // POWER hold (1 s)
  // BOOT hold: pop one internal level and return true, or return
  // false when at the root (framework exits to status).
  bool (*on_back)();
  // True while the body shows live-updating data: the chrome draws
  // the spinner and Display.h redraws at spinner rate.
  bool (*is_live)();
  // Auto-exit after this much input silence; 0 = sticky.
  uint32_t ttl_ms;
};

namespace _detail {
  inline constexpr size_t MAX_SCREENS = 8;
  inline const ScreenPage** screens_ref() { static const ScreenPage* v[MAX_SCREENS] = {nullptr}; return v; }
  inline size_t&  screen_count_ref() { static size_t v = 0; return v; }
  inline int&     active_ref()       { static int v = -1; return v; }   // -1 = status screen
  inline uint32_t& last_input_ms_ref() { static uint32_t v = 0; return v; }

  inline void enter(int idx) {
    const ScreenPage** s = screens_ref();
    int& a = active_ref();
    if (a == idx) return;
    if (a >= 0 && s[a]->on_exit) s[a]->on_exit();
    a = idx;
    last_input_ms_ref() = millis();
    if (a >= 0 && s[a]->on_enter) s[a]->on_enter();
  }
}

inline bool   active()       { return _detail::active_ref() >= 0; }
inline size_t screen_count() { return _detail::screen_count_ref(); }

// Register the screen rotation once at setup. Order = BOOT-tap order.
inline void set_screens(std::initializer_list<const ScreenPage*> pages) {
  const ScreenPage** s = _detail::screens_ref();
  size_t n = 0;
  for (const ScreenPage* p : pages) {
    if (n >= _detail::MAX_SCREENS) break;
    s[n++] = p;
  }
  _detail::screen_count_ref() = n;
}

inline void exit_active() { _detail::enter(-1); }

// Activate a specific registered page (out-of-band entries like the
// messenger's incoming-message view).
inline void activate(const ScreenPage* page) {
  const ScreenPage** s = _detail::screens_ref();
  for (size_t i = 0; i < _detail::screen_count_ref(); ++i) {
    if (s[i] == page) { _detail::enter((int)i); return; }
  }
}

// The active page's header title (diag + tests). "status" when none.
inline const char* active_title() {
  if (!active()) return "status";
  const uint8_t* g; const char* t = "?";
  const ScreenPage* p = _detail::screens_ref()[_detail::active_ref()];
  if (p->header) p->header(&g, &t);
  return t;
}

// ---- input routing (called from the firmware's button handlers) ----

// BOOT button. Returns true when consumed; false lets the caller run
// the global gesture tiers.
inline bool handle_boot(unsigned long duration_ms) {
  int& a = _detail::active_ref();
  if (duration_ms > BOOT_GLOBAL_MS) {
    // Long global gestures always win; just get out of the way.
    if (a >= 0) exit_active();
    return false;
  }
  _detail::last_input_ms_ref() = millis();
  if (duration_ms <= BOOT_HOLD_MS) {
    // Tap: enter the rotation, advance through it, wrap to status.
    if (_detail::screen_count_ref() == 0) return false;
    if (a < 0)                                   _detail::enter(0);
    else if ((size_t)(a + 1) < _detail::screen_count_ref()) _detail::enter(a + 1);
    else                                         exit_active();
    return true;
  }
  // Hold: back one level; at the page root, exit to status.
  if (a < 0) return false;
  const ScreenPage* p = _detail::screens_ref()[a];
  if (p->on_back && p->on_back()) return true;
  exit_active();
  return true;
}

// POWER key events from power_key_event(): 1 = tap, 2 = 1 s hold.
// Returns true when consumed (a page is active).
inline bool handle_power(uint8_t pk) {
  int a = _detail::active_ref();
  if (a < 0 || pk == 0) return false;
  _detail::last_input_ms_ref() = millis();
  const ScreenPage* p = _detail::screens_ref()[a];
  if (pk == 1) { if (p->on_next)   p->on_next();   }
  else         { if (p->on_select) p->on_select(); }
  return true;
}

// Call once per main-loop pass: TTL auto-dismiss.
inline void tick() {
  int a = _detail::active_ref();
  if (a < 0) return;
  const ScreenPage* p = _detail::screens_ref()[a];
  if (p->ttl_ms != 0
      && (millis() - _detail::last_input_ms_ref()) > p->ttl_ms) {
    exit_active();
  }
}

// True while the active page is live (Display.h raises the redraw
// cadence to spinner rate).
inline bool active_live() {
  int a = _detail::active_ref();
  if (a < 0) return false;
  const ScreenPage* p = _detail::screens_ref()[a];
  return p->is_live && p->is_live();
}

// ---- chrome + render ----

inline void render(GFXcanvas1& area) {
  int a = _detail::active_ref();
  if (a < 0) return;
  const ScreenPage* p = _detail::screens_ref()[a];
  const int16_t w = area.width();
  const int16_t h = area.height();

  area.fillRect(0, 0, w, h, 0);
  area.setTextWrap(false);
  area.setTextSize(1);
  area.setFont(&Picopixel);

  // Header: inverted bar, glyph at x=2, UPPERCASE title, centred to
  // the glyph midline via measured bounds (not eyeballed offsets).
  area.fillRect(0, 0, w, HEADER_H, 1);
  const uint8_t* glyph = nullptr;
  const char* title = "";
  if (p->header) p->header(&glyph, &title);
  if (glyph) area.drawBitmap(2, (HEADER_H - 8) / 2, glyph, 8, 8, 0);
  {
    int16_t x1, y1; uint16_t tw, th;
    area.getTextBounds(title, 0, 0, &x1, &y1, &tw, &th);
    // Baseline so the text block's vertical centre sits on the bar's
    // centre: bounds give the top offset (y1 is negative for
    // baseline-relative fonts).
    const int16_t baseline = (int16_t)((HEADER_H - (int16_t)th) / 2 - y1);
    area.setTextColor(0);
    area.setCursor(glyph ? 13 : 3, baseline);
    area.print(title);
  }
  // Live spinner at the right edge of the bar, drawn in black (the
  // exact inverse of the white-background frames).
  if (p->is_live && p->is_live()) {
    const uint8_t frame = (uint8_t)((millis() / SPINNER_FRAME_MS) & 3);
    area.drawBitmap(w - 10, (HEADER_H - 8) / 2, GLYPH_SPIN[frame], 8, 8, 0);
  }
  area.setTextColor(1);

  // Hint bar: inverted block at the bottom, one line per hint, with a
  // 1 px black gap above so it reads as a bar.
  const char* lines[3] = {nullptr, nullptr, nullptr};
  size_t n = p->hints ? p->hints(lines, 3) : 0;
  int16_t body_bottom = h;
  if (n > 0) {
    const int16_t bar_h = (int16_t)(4 + 7 * n);
    const int16_t bar_y = (int16_t)(h - bar_h);
    area.fillRect(0, bar_y, w, bar_h, 1);
    area.setTextColor(0);
    int16_t y = (int16_t)(bar_y + 9);
    for (size_t i = 0; i < n; ++i) {
      Common::OledText::line(area, y, lines[i]);
      y += 7;
    }
    area.setTextColor(1);
    body_bottom = (int16_t)(bar_y - 1);
  }

  if (p->render_body) p->render_body(area, BODY_TOP, body_bottom);
}

}  // namespace Screens
}  // namespace Display
